## conf/bblayers.conf.sample
```bitbake
# LAYER_CONF_VERSION is increased each time build/conf/bblayers.conf
# changes incompatibly
LCONF_VERSION = "6"

BBPATH = "${TOPDIR}"
BBFILES ?= ""

BBLAYERS ?= " \
  ##COREBASE##/meta \
  ##COREBASE##/meta-yocto \
  ##COREBASE##/meta-yocto-bsp \
  ##COREBASE##/meta-openembedded/meta-oe \
  ##COREBASE##/meta-openembedded/meta-networking \
  ##COREBASE##/meta-xilinx \
  ##COREBASE##/meta-xilinx-community \
  ##COREBASE##/meta-enclustra \
  "
  
BBLAYERS_NON_REMOVABLE ?= " \
  ##COREBASE##/meta \
  ##COREBASE##/meta-yocto \
  "
```

## conf/layer.conf
```bitbake
# We have a conf and classes directory, add to BBPATH
BBPATH .= ":${LAYERDIR}"

# We have recipes-* directories, add to BBFILES
BBFILES += "${LAYERDIR}/recipes-*/*/*.bb ${LAYERDIR}/recipes-*/*/*.bbappend"

BBFILE_COLLECTIONS += "enclustra"
BBFILE_PATTERN_enclustra = "^${LAYERDIR}/"
BBFILE_PRIORITY_enclustra = "10"

# This should only be incremented on significant changes that will
# cause compatibility issues with other layers
LAYERVERSION_enclustra = "1"

LAYERDEPENDS_enclustra = "core"
```
